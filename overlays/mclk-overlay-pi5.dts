/dts-v1/;
/plugin/;

/ {
    compatible = "brcm,bcm2712";

    fragment@0 {
        target-path = "/";
        __overlay__ {
            mclk: mclk {
                compatible = "fixed-clock";
                #clock-cells = <0>;
                clock-frequency = <12288000>; // 12.288 MHz
            };
        };
    };

    fragment@1 {
        target = <&rp1_gpio>;
        __overlay__ {
            mclk_pins: mclk_pins {
                brcm,pins = <4>;     // GPIO4
                brcm,function = <4>; // ALT0 (GPCLK0)
            };
        };
    };
};
